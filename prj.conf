## CMakeLists.txt
```
cmake_minimum_required(VERSION 3.20.0)
find_package(Zephyr REQUIRED HINTS $ENV{ZEPHYR_BASE})
project(ted)

target_include_directories(app PRIVATE include)
target_sources(app PRIVATE
    src/editor_core.c
    src/editor_view.c
    src/term_vt100.c
    src/fs_lfs.c
    src/editor_session.c
    src/cmd_edit.c
    app/main.c
)
```

## prj.conf
```kconfig
CONFIG_SHELL=y
CONFIG_SHELL_BACKEND_SERIAL=y
CONFIG_THREAD_NAME=y
# Keeps log output from corrupting the VT100 screen
CONFIG_SHELL_LOG_BACKEND=n

CONFIG_FLASH=y
CONFIG_FLASH_MAP=y
CONFIG_FLASH_PAGE_LAYOUT=y
CONFIG_FILE_SYSTEM=y
CONFIG_FILE_SYSTEM_LITTLEFS=y
CONFIG_FILE_SYSTEM_SHELL=y
# fs_mount() in main() (and the first-mount format) overflows the default 1 KB stack
CONFIG_MAIN_STACK_SIZE=2048

# Partition Manager: size of the littlefs_storage partition
CONFIG_PM_PARTITION_SIZE_LITTLEFS=0x6000
```

## include/cmd_edit.h
```c
/*
 * cmd_edit.h - Shell command entry point for the editor.
 *
 * Usage: edit [file]
 *
 * The command owns static editor storage sized by editor_config.h and
 * launches an editor session on the shell's terminal. On Zephyr the
 * `edit` command is registered with the Zephyr shell (via SHELL_CMD in
 * cmd_edit.c) and the shell's fprintf backend is used for terminal I/O.
 * On other platforms the caller wires the TERM callbacks itself and
 * invokes Cmd_edit() from its own shell command table (as ted.cpp does
 * with its "ed" command).
 */
#ifndef CMD_EDIT_H
#define CMD_EDIT_H

#include "term_vt100.h"

#ifdef __cplusplus
extern "C" {
#endif

/* Execute the edit command. argv[1] is the optional file path; without
 * it the user is asked for a name on write.
 * Returns 0 on success, negative on error. */
int Cmd_edit(TERM *term, int argc, char *argv[]);

#ifdef __cplusplus
}
#endif

#endif /* CMD_EDIT_H */
```

## include/editor_config.h
```c
/*
 * editor_config.h - Compile-time configuration and limits for the ted editor.
 *
 * All editor state is caller-provided static storage; these limits define
 * the maximum footprint so memory use is predictable on embedded targets.
 * Override any value at build time (e.g. -DEDITOR_MAX_BYTES=8192).
 */
#ifndef EDITOR_CONFIG_H
#define EDITOR_CONFIG_H

/* Legacy flat-buffer limits used by the standalone core tests. */
#ifndef EDITOR_MAX_BYTES
#define EDITOR_MAX_BYTES        4096
#endif

/* Maximum number of lines tracked by the line index. */
#ifndef EDITOR_MAX_LINES
#define EDITOR_MAX_LINES        256
#endif

/* Fixed RAM budgets for file-backed editing. */
#ifndef EDITOR_EDIT_BYTES
#define EDITOR_EDIT_BYTES       1024
#endif

#ifndef EDITOR_MAX_PIECES
#define EDITOR_MAX_PIECES       64
#endif

#ifndef EDITOR_PAGE_CACHE_BYTES
#define EDITOR_PAGE_CACHE_BYTES 256
#endif

#ifndef EDITOR_LINE_ANCHORS
#define EDITOR_LINE_ANCHORS     16
#endif

/* Default terminal size; safe fallbacks for serial consoles. */
#ifndef EDITOR_TERM_COLS
#define EDITOR_TERM_COLS        80
#endif

#ifndef EDITOR_TERM_ROWS
#define EDITOR_TERM_ROWS        24
#endif

/* Display width of a tab stop. */
#ifndef EDITOR_TAB_WIDTH
#define EDITOR_TAB_WIDTH        4
#endif

/* Non-printable characters are rendered as this glyph. */
#ifndef EDITOR_UNPRINTABLE_GLYPH
#define EDITOR_UNPRINTABLE_GLYPH '.'
#endif

/* Longest status line message. */
#ifndef EDITOR_STATUS_MAX
#define EDITOR_STATUS_MAX       96
#endif

/* Longest file path, including the terminator. */
#ifndef EDITOR_PATH_MAX
#define EDITOR_PATH_MAX         64
#endif

#endif /* EDITOR_CONFIG_H */
```

## include/editor_core.h
```c
/*
 * editor_core.h - Platform-neutral text buffer and editing logic.
 *
 * This module contains no Zephyr, OS, or I/O dependencies so it can be
 * unit tested on any host. The document is stored as a flat byte buffer
 * with an index of line start offsets; all storage is provided by the
 * caller, so no dynamic allocation is required.
 */
#ifndef EDITOR_CORE_H
#define EDITOR_CORE_H

#include <stddef.h>
#include <stdbool.h>
#include "editor_store.h"

#ifdef __cplusplus
extern "C" {
#endif

typedef enum {
    ED_OK = 0,          /* success */
    ED_FULL,            /* buffer or line index capacity reached */
    ED_RANGE,           /* argument outside the document */
    ED_INVALID,         /* invalid argument / not initialised */
    ED_IO               /* backing storage read failed */
} ED_Result;

typedef struct {
    char    *buf;         /* caller-provided text storage */
    size_t   buf_cap;     /* capacity of buf in bytes */
    size_t   len;         /* bytes currently used in buf */
    size_t  *lines;       /* caller-provided line start offsets */
    size_t   lines_cap;   /* capacity of lines */
    size_t   line_count;  /* number of lines in the document */
    size_t   cur;         /* cursor as an absolute buffer index */
    size_t   goal_col;    /* remembered column for vertical movement */
    bool     dirty;       /* modified since last load/save */
    ED_Store *store;      /* optional file-backed storage */
} ED_Doc;

/* Bind caller-provided storage and reset to an empty document. */
void ED_init(ED_Doc *doc, char *buf, size_t buf_cap,
             size_t *lines, size_t lines_cap);
void ED_init_store(ED_Doc *doc, ED_Store *store);

/* Replace the document with the given bytes (line endings are
 * normalised: CRLF and lone CR become LF). */
ED_Result ED_set_text(ED_Doc *doc, const char *data, size_t len);

/* Current document contents (bytes are in doc->buf, length returned). */
size_t ED_get_text(const ED_Doc *doc);
ED_Result ED_read_at(const ED_Doc *doc, size_t offset, char *dst, size_t len);
ED_Result ED_line_bounds(const ED_Doc *doc, size_t row,
                         size_t *start, size_t *len);

/* Editing operations. All update the line index and the dirty flag. */
ED_Result ED_insert_char(ED_Doc *doc, char ch);
ED_Result ED_insert_text(ED_Doc *doc, const char *s, size_t len);
ED_Result ED_newline(ED_Doc *doc);
ED_Result ED_backspace(ED_Doc *doc);    /* delete before cursor */
ED_Result ED_delete(ED_Doc *doc);       /* delete at cursor */

/* Cursor movement. */
void ED_cursor_home(ED_Doc *doc);       /* start of line */
void ED_cursor_end(ED_Doc *doc);        /* end of line */
void ED_move_left(ED_Doc *doc);
void ED_move_right(ED_Doc *doc);
void ED_move_up(ED_Doc *doc);
void ED_move_down(ED_Doc *doc);
void ED_move_page_up(ED_Doc *doc, size_t page_rows);
void ED_move_page_down(ED_Doc *doc, size_t page_rows);

/* Cursor and line queries. */
void         ED_get_cursor(const ED_Doc *doc, size_t *row, size_t *col);
size_t       ED_line_count(const ED_Doc *doc);
size_t       ED_line_len(const ED_Doc *doc, size_t row);
const char  *ED_line_text(const ED_Doc *doc, size_t row);
bool         ED_is_dirty(const ED_Doc *doc);
void         ED_clear_dirty(ED_Doc *doc);

#ifdef __cplusplus
}
#endif

#endif /* EDITOR_CORE_H */
```

## include/editor_session.h
```c
/*
 * editor_session.h - One interactive editing run.
 *
 * Ties together the editor core, view, VT100 terminal, and filesystem:
 * loads the file, runs the event loop (draw, read key, apply action),
 * saves on request, and restores the terminal on exit. All storage is
 * supplied by the caller through ED_SessionConfig.
 */
#ifndef EDITOR_SESSION_H
#define EDITOR_SESSION_H

#include <stddef.h>
#include "editor_config.h"
#include "editor_core.h"
#include "editor_view.h"
#include "fs_lfs.h"
#include "term_vt100.h"

#ifdef __cplusplus
extern "C" {
#endif

typedef enum {
    ED_SESSION_OK = 0,      /* quit, file saved or unchanged */
    ED_SESSION_DISCARDED,   /* quit without saving changes */
    ED_SESSION_IO_ERROR,    /* load/save failed */
    ED_SESSION_ARG_ERROR    /* bad configuration */
} ED_SessionResult;

typedef struct {
    const char *path;                 /* file to edit, NULL = unnamed */
    TERM       *term;                 /* initialised terminal (required) */
    char       *buf;                  /* text storage (required) */
    size_t      buf_cap;
    size_t     *lines;                /* line index storage (required) */
    size_t      lines_cap;
    size_t      term_rows;            /* terminal size, 0 = defaults */
    size_t      term_cols;
    ED_Store   *store;                /* non-NULL selects file-backed mode */
    ED_StorePiece *pieces;
    size_t      pieces_cap;
    char       *added;
    size_t      added_cap;
    char       *cache;
    size_t      cache_cap;
    ED_StoreLineAnchor *anchors;
    size_t      anchors_cap;
    FS_LFS_File *source;
} ED_SessionConfig;

/* Run the editor until the user quits. Blocks reading keys from
 * cfg->term. The terminal is put into/taken out of editor mode by this
 * call. */
ED_SessionResult ED_Session_run(const ED_SessionConfig *cfg);

#ifdef __cplusplus
}
#endif

#endif /* EDITOR_SESSION_H */
```

## include/editor_store.h
```c
/*
 * editor_store.h - Bounded piece-table storage for large documents.
 *
 * The original document remains in its backing store. Inserted bytes are
 * held in caller-provided memory until save; no storage writes occur here.
 */
#ifndef EDITOR_STORE_H
#define EDITOR_STORE_H

#include <stdbool.h>
#include <stddef.h>

#ifdef __cplusplus
extern "C" {
#endif

typedef size_t (*ED_StoreReadAt)(void *ctx, size_t offset, char *dst,
                                 size_t len);

typedef enum {
    ED_STORE_OK = 0,
    ED_STORE_FULL,
    ED_STORE_RANGE,
    ED_STORE_IO,
    ED_STORE_INVALID
} ED_StoreResult;

typedef struct {
    size_t start;
    size_t len;
    bool added;
} ED_StorePiece;

typedef struct {
    size_t row;
    size_t offset;
} ED_StoreLineAnchor;

typedef struct {
    ED_StoreReadAt read_at;
    void *source_ctx;
    size_t source_len;
    size_t len;
    size_t line_count;
    ED_StorePiece *pieces;
    size_t piece_count;
    size_t pieces_cap;
    char *added;
    size_t added_len;
    size_t added_cap;
    char *cache;
    size_t cache_cap;
    size_t cache_start;
    size_t cache_len;
    ED_StoreLineAnchor *anchors;
    size_t anchor_count;
    size_t anchors_cap;
    bool cache_valid;
} ED_Store;

void ED_Store_init(ED_Store *store, ED_StoreReadAt read_at, void *source_ctx,
                   size_t source_len, ED_StorePiece *pieces,
                   size_t pieces_cap, char *added, size_t added_cap,
                   char *cache, size_t cache_cap,
                   ED_StoreLineAnchor *anchors, size_t anchors_cap);

size_t ED_Store_length(const ED_Store *store);
size_t ED_Store_line_count(const ED_Store *store);
ED_StoreResult ED_Store_read(ED_Store *store, size_t offset, char *dst,
                             size_t len);
ED_StoreResult ED_Store_insert(ED_Store *store, size_t offset,
                               const char *data, size_t len);
ED_StoreResult ED_Store_delete(ED_Store *store, size_t offset, size_t len);
ED_StoreResult ED_Store_line_bounds(ED_Store *store, size_t row,
                                    size_t *start, size_t *len);
ED_StoreResult ED_Store_position_at(ED_Store *store, size_t offset,
                                    size_t *row, size_t *col);

#ifdef __cplusplus
}
#endif

#endif /* EDITOR_STORE_H */
```

## include/editor_view.h
```c
/*
 * editor_view.h - Viewport and scroll state for the editor.
 *
 * Converts ED_Doc state into screen coordinates: which document lines
 * are visible, where the hardware cursor belongs, and how far lines
 * must be horizontally scrolled. No terminal or OS dependencies.
 */
#ifndef EDITOR_VIEW_H
#define EDITOR_VIEW_H

#include <stddef.h>
#include "editor_core.h"

#ifdef __cplusplus
extern "C" {
#endif

typedef struct {
    size_t cols;      /* terminal width in columns */
    size_t rows;      /* terminal height in rows (including status row) */
    size_t top;       /* first visible document row */
    size_t left;      /* horizontal scroll offset in columns */
} ED_View;

/* rows is the full terminal height; one row is reserved for the status
 * line, so text_rows = rows - 1 (clamped at 1). */
void   EDV_init(ED_View *v, size_t rows, size_t cols);
void   EDV_set_size(ED_View *v, size_t rows, size_t cols);

size_t EDV_text_rows(const ED_View *v);
size_t EDV_text_cols(const ED_View *v);

/* Adjust scroll offsets so the document cursor is visible. */
void   EDV_ensure_cursor_visible(ED_View *v, const ED_Doc *doc);

/* Visible document row range: [first, last), last clamped to the
 * document line count. */
void   EDV_visible_range(const ED_View *v, const ED_Doc *doc,
                         size_t *first, size_t *last);

/* Screen position of the document cursor (0-based) after scrolling.
 * Requires EDV_ensure_cursor_visible() to have been applied. */
void   EDV_cursor_screen_pos(const ED_View *v, const ED_Doc *doc,
                             size_t *row, size_t *col);

/* Display column of a character offset within a line, expanding tabs. */
size_t EDV_display_col(const ED_Doc *doc, size_t row, size_t char_off);

#ifdef __cplusplus
}
#endif

#endif /* EDITOR_VIEW_H */
```

## include/fs_lfs.h
```c
/*
 * fs_lfs.h - File load/save wrapper for the editor.
 *
 * Under Zephyr (__ZEPHYR__) this uses the Zephyr filesystem API
 * (<zephyr/fs/fs.h>), which typically mounts LittleFS for on-device flash
 * storage. On a host build it falls back to stdio so the same code can be
 * exercised by unit tests. Random-access reads and streamed saves avoid
 * loading the source file into RAM.
 */
#ifndef FS_LFS_H
#define FS_LFS_H

#include <stdbool.h>
#include <stddef.h>
#include "editor_config.h"

#ifdef __ZEPHYR__
#include <zephyr/fs/fs.h>
#else
#include <stdio.h>
#endif

#ifdef __cplusplus
extern "C" {
#endif

typedef enum {
    FS_LFS_OK = 0,
    FS_LFS_NOT_FOUND,   /* path does not exist (load only) */
    FS_LFS_TOO_LARGE,   /* file exceeds the caller's buffer */
    FS_LFS_IO           /* any other I/O error */
} FS_LFS_Result;

typedef struct {
#ifdef __ZEPHYR__
    struct fs_file_t file;
#else
    FILE *file;
#endif
    size_t size;
    bool open;
    char path[EDITOR_PATH_MAX];
} FS_LFS_File;

typedef size_t (*FS_LFS_ReadAt)(void *ctx, size_t offset, char *dst, size_t len);

FS_LFS_Result FS_LFS_open_read(const char *path, FS_LFS_File *file);
void FS_LFS_close(FS_LFS_File *file);
size_t FS_LFS_read_at(void *ctx, size_t offset, char *dst, size_t len);
FS_LFS_Result FS_LFS_save_stream(const char *path, size_t len,
                                 FS_LFS_ReadAt read_at, void *ctx,
                                 FS_LFS_File *source);

/* Read the whole file into buf. *len receives the byte count on success.
 * A missing file is reported as FS_LFS_NOT_FOUND so the caller can start
 * with an empty buffer. */
FS_LFS_Result FS_LFS_load(const char *path, char *buf, size_t cap, size_t *len);

/* Write len bytes to path, replacing any existing file. */
FS_LFS_Result FS_LFS_save(const char *path, const char *buf, size_t len);

#ifdef __cplusplus
}
#endif

#endif /* FS_LFS_H */
```

## include/term_vt100.h
```c
/*
 * term_vt100.h - VT100 terminal rendering and key decoding.
 *
 * All I/O goes through caller-supplied callbacks, so this module has no
 * OS dependencies: on Zephyr the callbacks write to the shell/UART, on a
 * host they can write to stdout or a test harness. Output uses VT100
 * escape sequences only; input is decoded from raw terminal bytes into
 * editor key events (printable characters, control keys, and common
 * ANSI/VT100 escape sequences for arrows and navigation keys).
 */
#ifndef TERM_VT100_H
#define TERM_VT100_H

#include <stddef.h>
#include <stdbool.h>
#include "editor_core.h"
#include "editor_view.h"

#ifdef __cplusplus
extern "C" {
#endif

typedef enum {
    TERM_KEY_NONE = 0,   /* ignored byte or unrecognised sequence */
    TERM_KEY_CHAR,       /* printable character in ch */
    TERM_KEY_ENTER,
    TERM_KEY_BACKSPACE,
    TERM_KEY_DELETE,
    TERM_KEY_TAB,
    TERM_KEY_UP,
    TERM_KEY_DOWN,
    TERM_KEY_LEFT,
    TERM_KEY_RIGHT,
    TERM_KEY_HOME,
    TERM_KEY_END,
    TERM_KEY_PAGE_UP,
    TERM_KEY_PAGE_DOWN,
    TERM_KEY_CTRL_W,     /* write */
    TERM_KEY_CTRL_X,     /* exit */
    TERM_KEY_CTRL_C      /* cancel prompt */
} TERM_KeyType;

typedef struct {
    TERM_KeyType type;
    char         ch;    /* valid when type == TERM_KEY_CHAR */
} TERM_Key;

typedef size_t (*TERM_WriteFn)(void *ctx, const char *data, size_t len);
typedef int    (*TERM_ReadFn)(void *ctx);   /* returns byte 0..255 or -1 */

typedef struct {
    TERM_WriteFn write;
    TERM_ReadFn  read;
    void        *ctx;
    int          esc_state;   /* escape sequence decoder state (private) */
    int          esc_param;   /* CSI parameter byte being decoded (private) */
} TERM;

/* Attach I/O callbacks. write is required; read may be NULL if only
 * rendering is used. */
void TERM_init(TERM *t, TERM_WriteFn write, TERM_ReadFn read, void *ctx);

/* Raw output helpers. */
void TERM_write(TERM *t, const char *s);
void TERM_write_n(TERM *t, const char *s, size_t len);

/* VT100 rendering primitives (rows/cols are 1-based on the wire). */
void TERM_enter(TERM *t);          /* alternate screen, hide cursor */
void TERM_exit(TERM *t);           /* show cursor, leave alternate screen */
void TERM_clear_screen(TERM *t);
void TERM_clear_line(TERM *t);
void TERM_move_to(TERM *t, size_t row, size_t col);
void TERM_hide_cursor(TERM *t);
void TERM_show_cursor(TERM *t);
void TERM_reverse_video(TERM *t);
void TERM_normal_video(TERM *t);

/* Full-screen redraw: document lines within the viewport, reverse-video
 * status line on the last row, then cursor placement. */
void TERM_render(TERM *t, const ED_Doc *doc, const ED_View *view,
                 const char *status);

/* Partial redraw: status line and cursor only. Valid when the text area
 * on screen still matches doc/view (e.g. cursor moved within the page). */
void TERM_render_cursor(TERM *t, const ED_Doc *doc, const ED_View *view,
                        const char *status);

/* Blocking read of one decoded key. Unrecognised bytes are consumed and
 * reported as TERM_KEY_NONE. Returns false only if read is unavailable
 * or the stream ended. */
bool TERM_read_key(TERM *t, TERM_Key *key);

/* Feed one raw byte into the key decoder. Produces a key when one is
 * complete (returns true), or false if more bytes are needed / the byte
 * was ignored. Exposed for tests and polling loops. */
bool TERM_feed_byte(TERM *t, int byte, TERM_Key *key);

#ifdef __cplusplus
}
#endif

#endif /* TERM_VT100_H */
```

## src/cmd_edit.c
```c
/*
 * cmd_edit.c - Shell command entry point:  edit [file]
 *
 * Owns the static editor storage (sized by editor_config.h) and starts an
 * editing session on the caller's terminal. Under Zephyr the `edit`
 * command is registered with the Zephyr shell and terminal I/O goes
 * through the shell's fprintf backend; elsewhere the host shell provides
 * the TERM callbacks and calls Cmd_edit() directly.
 */
#include "editor_config.h"
#include "editor_session.h"
#include "cmd_edit.h"

/* Static, bounded storage: the source file is never copied into RAM. */
static ED_Store s_store;
static ED_StorePiece s_pieces[EDITOR_MAX_PIECES];
static char s_added[EDITOR_EDIT_BYTES];
static char s_cache[EDITOR_PAGE_CACHE_BYTES];
static ED_StoreLineAnchor s_anchors[EDITOR_LINE_ANCHORS];
static FS_LFS_File s_source;

int Cmd_edit(TERM *term, int argc, char *argv[])
{
    ED_SessionConfig cfg;
    ED_SessionResult rc;

    if (term == NULL || argv == NULL) {
        return -1;
    }

    cfg.path = (argc >= 2 && argv[1] != NULL && argv[1][0] != '\0') ?
               argv[1] : NULL;
    cfg.term = term;
    cfg.buf = NULL;
    cfg.buf_cap = 0;
    cfg.lines = NULL;
    cfg.lines_cap = 0;
    cfg.term_rows = EDITOR_TERM_ROWS;
    cfg.term_cols = EDITOR_TERM_COLS;
    cfg.store = &s_store;
    cfg.pieces = s_pieces;
    cfg.pieces_cap = EDITOR_MAX_PIECES;
    cfg.added = s_added;
    cfg.added_cap = sizeof(s_added);
    cfg.cache = s_cache;
    cfg.cache_cap = sizeof(s_cache);
    cfg.anchors = s_anchors;
    cfg.anchors_cap = EDITOR_LINE_ANCHORS;
    cfg.source = &s_source;

    rc = ED_Session_run(&cfg);
    switch (rc) {
    case ED_SESSION_OK:
    case ED_SESSION_DISCARDED:
        return 0;
    default:
        return -2;
    }
}

#ifdef __ZEPHYR__

#include <errno.h>
#include <string.h>
#include <zephyr/kernel.h>
#include <zephyr/shell/shell.h>
#include <zephyr/sys/atomic.h>

#ifndef EDITOR_THREAD_STACK_SIZE
#define EDITOR_THREAD_STACK_SIZE 4096
#endif

#ifndef EDITOR_THREAD_PRIORITY
#define EDITOR_THREAD_PRIORITY   K_LOWEST_APPLICATION_THREAD_PRIO
#endif

#ifndef EDITOR_RX_QUEUE_LEN
#define EDITOR_RX_QUEUE_LEN      64
#endif

/* The editor runs in its own thread; the shell forwards raw input bytes to
 * it through the bypass callback while the editor owns the screen. */
K_THREAD_STACK_DEFINE(s_ed_stack, EDITOR_THREAD_STACK_SIZE);
K_MSGQ_DEFINE(s_rx_q, sizeof(uint8_t), EDITOR_RX_QUEUE_LEN, 1);

static struct k_thread s_ed_thread;
static atomic_t s_busy;
static const struct shell *s_shell;
static char s_path[EDITOR_PATH_MAX];

static void editor_bypass(const struct shell *sh, uint8_t *data, size_t len)
{
    size_t i;

    ARG_UNUSED(sh);
    for (i = 0; i < len; i++) {
        (void)k_msgq_put(&s_rx_q, &data[i], K_NO_WAIT);
    }
}

static size_t zephyr_term_write(void *ctx, const char *data, size_t len)
{
    shell_fprintf((const struct shell *)ctx, SHELL_NORMAL, "%.*s", (int)len,
                  data);
    return len;
}

static int zephyr_term_read(void *ctx)
{
    uint8_t c;

    ARG_UNUSED(ctx);
    if (k_msgq_get(&s_rx_q, &c, K_FOREVER) != 0) {
        return -1;
    }
    return c;
}

static void editor_thread(void *p1, void *p2, void *p3)
{
    const struct shell *sh = s_shell;
    char *argv[] = { "edit", s_path, NULL };
    TERM term;
    int rc;

    ARG_UNUSED(p1);
    ARG_UNUSED(p2);
    ARG_UNUSED(p3);

    TERM_init(&term, zephyr_term_write, zephyr_term_read, (void *)sh);
    rc = Cmd_edit(&term, s_path[0] != '\0' ? 2 : 1, argv);

    shell_set_bypass(sh, NULL);
    if (rc != 0) {
        shell_error(sh, "edit: failed (%d)", rc);
    }
    atomic_clear(&s_busy);
}

static int cmd_edit_zephyr(const struct shell *sh, size_t argc, char **argv)
{
    const char *name = (argc >= 2) ? argv[1] : "";

    if (strlen(name) >= sizeof(s_path)) {
        shell_error(sh, "edit: path too long");
        return -ENAMETOOLONG;
    }
    if (!atomic_cas(&s_busy, 0, 1)) {
        shell_error(sh, "edit: editor already running");
        return -EBUSY;
    }

    strcpy(s_path, name);
    s_shell = sh;
    k_msgq_purge(&s_rx_q);
    shell_set_bypass(sh, editor_bypass);

    /* Delay start so the shell finishes printing its prompt before the first redraw. */
    k_thread_create(&s_ed_thread, s_ed_stack, K_THREAD_STACK_SIZEOF(s_ed_stack),
                    editor_thread, NULL, NULL, NULL,
                    EDITOR_THREAD_PRIORITY, 0, K_MSEC(50));
    k_thread_name_set(&s_ed_thread, "ted");
    return 0;
}

SHELL_CMD_ARG_REGISTER(edit, NULL, "edit a file: edit [file]",
                       cmd_edit_zephyr, 1, 1);

#endif /* __ZEPHYR__ */
```

## src/editor_core.c
```c
/*
 * editor_core.c - Platform-neutral text buffer and editing logic.
 *
 * Flat byte buffer plus an index of line start offsets. The cursor is an
 * absolute buffer index; row/col are derived from the line index. No
 * dynamic allocation and no I/O, so the module is fully unit testable.
 */
#include <string.h>

#include "editor_config.h"
#include "editor_core.h"

static bool ed_valid(const ED_Doc *doc)
{
    return doc != NULL &&
           (doc->store != NULL ||
            (doc->buf != NULL && doc->lines != NULL && doc->lines_cap > 0));
}

static size_t ed_doc_len(const ED_Doc *doc)
{
    return doc->store != NULL ? ED_Store_length(doc->store) : doc->len;
}

static size_t ed_doc_lines(const ED_Doc *doc)
{
    return doc->store != NULL ? ED_Store_line_count(doc->store) :
                                doc->line_count;
}

static ED_Result ed_read_byte(const ED_Doc *doc, size_t offset, char *ch)
{
    if (doc->store != NULL) {
        ED_StoreResult rc = ED_Store_read(doc->store, offset, ch, 1);

        return rc == ED_STORE_OK ? ED_OK :
               rc == ED_STORE_IO ? ED_IO : ED_RANGE;
    }
    if (offset >= doc->len) {
        return ED_RANGE;
    }
    *ch = doc->buf[offset];
    return ED_OK;
}

/* Byte offset where line row starts. */
static size_t ed_line_start(const ED_Doc *doc, size_t row)
{
    if (doc->store != NULL) {
        size_t start = doc->len, len;

        (void)ED_Store_line_bounds(doc->store, row, &start, &len);
        return start;
    }
    return (row < doc->line_count) ? doc->lines[row] : doc->len;
}

/* Byte offset where line row ends, excluding the '\n'. */
static size_t ed_line_end(const ED_Doc *doc, size_t row)
{
    size_t start = ed_line_start(doc, row);
    size_t end;

    if (doc->store != NULL) {
        size_t len;

        if (ED_Store_line_bounds(doc->store, row, &start, &len) !=
            ED_STORE_OK) {
            return start;
        }
        return start + len;
    }
    if (row + 1 < doc->line_count) {
        end = doc->lines[row + 1];
        if (end > start && doc->buf[end - 1] == '\n') {
            end--;
        }
    } else {
        end = doc->len;
    }
    return end;
}

static size_t ed_cur_row(const ED_Doc *doc)
{
    size_t row = 0;

    if (doc->store != NULL) {
        size_t col;

        (void)ED_Store_position_at(doc->store, doc->cur, &row, &col);
        return row;
    }
    while (row + 1 < doc->line_count && doc->lines[row + 1] <= doc->cur) {
        row++;
    }
    return row;
}

/* Buffer index of (row, col), clamped to the line length. */
static size_t ed_pos_to_index(const ED_Doc *doc, size_t row, size_t col)
{
    size_t start = ed_line_start(doc, row);
    size_t end = ed_line_end(doc, row);
    size_t idx = start + col;

    return (idx > end) ? end : idx;
}

/* Insert raw bytes at the cursor, maintaining the line index. */
static ED_Result ed_insert(ED_Doc *doc, const char *data, size_t n)
{
    size_t newlines = 0;
    size_t i, row;

    if (!ed_valid(doc) || (data == NULL && n > 0)) {
        return ED_INVALID;
    }
    if (doc->store != NULL) {
        ED_StoreResult rc = ED_Store_insert(doc->store, doc->cur, data, n);

        if (rc == ED_STORE_FULL) {
            return ED_FULL;
        }
        if (rc == ED_STORE_IO) {
            return ED_IO;
        }
        if (rc != ED_STORE_OK) {
            return ED_INVALID;
        }
        doc->len = ED_Store_length(doc->store);
        doc->line_count = ED_Store_line_count(doc->store);
        doc->cur += n;
        doc->dirty = n > 0 || doc->dirty;
        return ED_OK;
    }
    for (i = 0; i < n; i++) {
        if (data[i] == '\n') {
            newlines++;
        }
    }
    if (doc->len + n > doc->buf_cap) {
        return ED_FULL;
    }
    if (doc->line_count + newlines > doc->lines_cap) {
        return ED_FULL;
    }

    memmove(doc->buf + doc->cur + n, doc->buf + doc->cur, doc->len - doc->cur);
    if (n > 0) {
        memcpy(doc->buf + doc->cur, data, n);
    }
    doc->len += n;

    if (newlines > 0) {
        size_t base = doc->cur;

        row = ed_cur_row(doc);
        memmove(doc->lines + row + 1 + newlines, doc->lines + row + 1,
                (doc->line_count - (row + 1)) * sizeof(size_t));
        for (i = row + 1 + newlines; i < doc->line_count + newlines; i++) {
            doc->lines[i] += n;
        }
        for (i = 0; i < n; i++) {
            if (doc->buf[base + i] == '\n') {
                doc->lines[row + 1] = base + i + 1;
                row++;
            }
        }
        doc->line_count += newlines;
    } else {
        /* Shift line starts after the cursor. */
        row = ed_cur_row(doc);
        for (i = row + 1; i < doc->line_count; i++) {
            doc->lines[i] += n;
        }
    }

    doc->cur += n;
    doc->dirty = true;
    return ED_OK;
}

/* Delete n bytes at the cursor, maintaining the line index. */
static ED_Result ed_delete_at(ED_Doc *doc, size_t cur, size_t n)
{
    size_t row, i, end, removed_lines = 0;

    if (!ed_valid(doc) || n == 0 || cur >= doc->len) {
        return ED_RANGE;
    }
    if (doc->store != NULL) {
        ED_StoreResult rc = ED_Store_delete(doc->store, cur, n);

        if (rc == ED_STORE_IO) {
            return ED_IO;
        }
        if (rc != ED_STORE_OK) {
            return rc == ED_STORE_FULL ? ED_FULL : ED_RANGE;
        }
        doc->len = ED_Store_length(doc->store);
        doc->line_count = ED_Store_line_count(doc->store);
        doc->cur = cur;
        doc->dirty = true;
        return ED_OK;
    }
    if (cur + n > doc->len) {
        n = doc->len - cur;
    }

    row = 0;
    while (row + 1 < doc->line_count && doc->lines[row + 1] <= cur) {
        row++;
    }
    end = cur + n;
    for (i = row + 1; i < doc->line_count; i++) {
        if (doc->lines[i] <= end) {
            removed_lines++;    /* whole line start swallowed by delete */
        } else {
            doc->lines[i - removed_lines] = doc->lines[i] - n;
        }
    }
    doc->line_count -= removed_lines;

    memmove(doc->buf + cur, doc->buf + cur + n, doc->len - (cur + n));
    doc->len -= n;
    doc->cur = cur;
    doc->dirty = true;
    return ED_OK;
}

void ED_init(ED_Doc *doc, char *buf, size_t buf_cap,
             size_t *lines, size_t lines_cap)
{
    if (doc == NULL) {
        return;
    }
    doc->buf = buf;
    doc->buf_cap = buf_cap;
    doc->len = 0;
    doc->lines = lines;
    doc->lines_cap = lines_cap;
    doc->line_count = 1;
    if (lines != NULL && lines_cap > 0) {
        lines[0] = 0;
    }
    doc->cur = 0;
    doc->goal_col = 0;
    doc->dirty = false;
    doc->store = NULL;
}

void ED_init_store(ED_Doc *doc, ED_Store *store)
{
    if (doc == NULL || store == NULL) {
        return;
    }
    doc->buf = NULL;
    doc->buf_cap = 0;
    doc->len = ED_Store_length(store);
    doc->lines = NULL;
    doc->lines_cap = 0;
    doc->line_count = ED_Store_line_count(store);
    doc->cur = 0;
    doc->goal_col = 0;
    doc->dirty = false;
    doc->store = store;
}

ED_Result ED_set_text(ED_Doc *doc, const char *data, size_t len)
{
    size_t i, out = 0;

    if (!ed_valid(doc) || doc->store != NULL || (data == NULL && len > 0)) {
        return ED_INVALID;
    }

    doc->len = 0;
    doc->line_count = 1;
    doc->lines[0] = 0;

    /* Copy with line-ending normalisation; stop cleanly at capacity. */
    for (i = 0; i < len; i++) {
        char ch = data[i];

        if (ch == '\r') {
            if (i + 1 < len && data[i + 1] == '\n') {
                i++;    /* CRLF -> LF */
            }
            ch = '\n';
        }
        if (ch == '\n') {
            if (out + 1 > doc->buf_cap ||
                doc->line_count + 1 > doc->lines_cap) {
                break;
            }
            doc->lines[doc->line_count++] = out + 1;
        } else {
            if (out + 1 > doc->buf_cap) {
                break;
            }
        }
        doc->buf[out++] = ch;
    }
    doc->len = out;
    doc->cur = 0;
    doc->goal_col = 0;
    doc->dirty = false;
    return ED_OK;
}

size_t ED_get_text(const ED_Doc *doc)
{
    return ed_valid(doc) ? ed_doc_len(doc) : 0;
}

ED_Result ED_read_at(const ED_Doc *doc, size_t offset, char *dst, size_t len)
{
    if (!ed_valid(doc) || (dst == NULL && len > 0) ||
        offset > ed_doc_len(doc) || len > ed_doc_len(doc) - offset) {
        return ED_RANGE;
    }
    if (doc->store != NULL) {
        ED_StoreResult rc = ED_Store_read(doc->store, offset, dst, len);

        return rc == ED_STORE_OK ? ED_OK :
               rc == ED_STORE_IO ? ED_IO : ED_RANGE;
    }
    if (len > 0) {
        memcpy(dst, doc->buf + offset, len);
    }
    return ED_OK;
}

ED_Result ED_line_bounds(const ED_Doc *doc, size_t row,
                         size_t *start, size_t *len)
{
    if (!ed_valid(doc) || start == NULL || len == NULL ||
        row >= ed_doc_lines(doc)) {
        return ED_RANGE;
    }
    if (doc->store != NULL) {
        ED_StoreResult rc = ED_Store_line_bounds(doc->store, row, start, len);

        return rc == ED_STORE_OK ? ED_OK :
               rc == ED_STORE_IO ? ED_IO : ED_RANGE;
    }
    *start = ed_line_start(doc, row);
    *len = ed_line_end(doc, row) - *start;
    return ED_OK;
}

ED_Result ED_insert_char(ED_Doc *doc, char ch)
{
    ED_Result rc = ed_insert(doc, &ch, 1);

    if (rc == ED_OK) {
        size_t row = ed_cur_row(doc);
        doc->goal_col = doc->cur - ed_line_start(doc, row);
    }
    return rc;
}

ED_Result ED_insert_text(ED_Doc *doc, const char *s, size_t len)
{
    ED_Result rc = ed_insert(doc, s, len);

    if (rc == ED_OK) {
        size_t row = ed_cur_row(doc);
        doc->goal_col = doc->cur - ed_line_start(doc, row);
    }
    return rc;
}

ED_Result ED_newline(ED_Doc *doc)
{
    return ED_insert_char(doc, '\n');
}

ED_Result ED_backspace(ED_Doc *doc)
{
    size_t remove = 1;

    if (!ed_valid(doc)) {
        return ED_INVALID;
    }
    if (doc->cur == 0) {
        return ED_RANGE;
    }
    if (doc->store != NULL && doc->cur >= 2) {
        char before, last;

        if (ed_read_byte(doc, doc->cur - 2, &before) == ED_OK &&
            ed_read_byte(doc, doc->cur - 1, &last) == ED_OK &&
            before == '\r' && last == '\n') {
            remove = 2;
        }
    }
    return ed_delete_at(doc, doc->cur - remove, remove);
}

ED_Result ED_delete(ED_Doc *doc)
{
    size_t remove = 1;

    if (!ed_valid(doc)) {
        return ED_INVALID;
    }
    if (doc->cur >= doc->len) {
        return ED_RANGE;
    }
    if (doc->store != NULL && doc->cur + 1 < doc->len) {
        char current, next;

        if (ed_read_byte(doc, doc->cur, &current) == ED_OK &&
            ed_read_byte(doc, doc->cur + 1, &next) == ED_OK &&
            current == '\r' && next == '\n') {
            remove = 2;
        }
    }
    return ed_delete_at(doc, doc->cur, remove);
}

void ED_get_cursor(const ED_Doc *doc, size_t *row, size_t *col)
{
    size_t r;

    if (!ed_valid(doc)) {
        if (row != NULL) {
            *row = 0;
        }
        if (col != NULL) {
            *col = 0;
        }
        return;
    }
    if (doc->store != NULL) {
        (void)ED_Store_position_at(doc->store, doc->cur, &r, col);
        if (row != NULL) {
            *row = r;
        }
        return;
    }
    r = ed_cur_row(doc);
    if (row != NULL) {
        *row = r;
    }
    if (col != NULL) {
        *col = doc->cur - ed_line_start(doc, r);
    }
}

void ED_cursor_home(ED_Doc *doc)
{
    if (!ed_valid(doc)) {
        return;
    }
    doc->cur = ed_line_start(doc, ed_cur_row(doc));
    doc->goal_col = 0;
}

void ED_cursor_end(ED_Doc *doc)
{
    size_t row;

    if (!ed_valid(doc)) {
        return;
    }
    row = ed_cur_row(doc);
    doc->cur = ed_line_end(doc, row);
    doc->goal_col = doc->cur - ed_line_start(doc, row);
}

void ED_move_left(ED_Doc *doc)
{
    if (!ed_valid(doc) || doc->cur == 0) {
        return;
    }
    if (doc->store != NULL && doc->cur >= 2) {
        char before, last;

        if (ed_read_byte(doc, doc->cur - 2, &before) == ED_OK &&
            ed_read_byte(doc, doc->cur - 1, &last) == ED_OK &&
            before == '\r' && last == '\n') {
            doc->cur -= 2;
        } else {
            doc->cur--;
        }
    } else {
        doc->cur--;
    }
    doc->goal_col = doc->cur - ed_line_start(doc, ed_cur_row(doc));
}

void ED_move_right(ED_Doc *doc)
{
    if (!ed_valid(doc) || doc->cur >= doc->len) {
        return;
    }
    if (doc->store != NULL && doc->cur + 1 < doc->len) {
        char current, next;

        if (ed_read_byte(doc, doc->cur, &current) == ED_OK &&
            ed_read_byte(doc, doc->cur + 1, &next) == ED_OK &&
            current == '\r' && next == '\n') {
            doc->cur += 2;
        } else {
            doc->cur++;
        }
    } else {
        doc->cur++;
    }
    doc->goal_col = doc->cur - ed_line_start(doc, ed_cur_row(doc));
}

void ED_move_up(ED_Doc *doc)
{
    size_t row;

    if (!ed_valid(doc)) {
        return;
    }
    row = ed_cur_row(doc);
    if (row == 0) {
        return;
    }
    /* goal_col holds the horizontal target set by the last horizontal
     * movement or edit; vertical moves keep it so repeated up/down
     * presses return to the same column when lines allow. */
    doc->cur = ed_pos_to_index(doc, row - 1, doc->goal_col);
}

void ED_move_down(ED_Doc *doc)
{
    size_t row;

    if (!ed_valid(doc)) {
        return;
    }
    row = ed_cur_row(doc);
    if (row + 1 >= doc->line_count) {
        return;
    }
    doc->cur = ed_pos_to_index(doc, row + 1, doc->goal_col);
}

void ED_move_page_up(ED_Doc *doc, size_t page_rows)
{
    size_t row, col, target;

    if (!ed_valid(doc)) {
        return;
    }
    row = ed_cur_row(doc);
    col = doc->cur - ed_line_start(doc, row);
    target = (row > page_rows) ? row - page_rows : 0;
    doc->cur = ed_pos_to_index(doc, target, col);
    doc->goal_col = col;
}

void ED_move_page_down(ED_Doc *doc, size_t page_rows)
{
    size_t row, col, target;

    if (!ed_valid(doc)) {
        return;
    }
    row = ed_cur_row(doc);
    col = doc->cur - ed_line_start(doc, row);
    target = row + page_rows;
    if (target >= doc->line_count) {
        target = doc->line_count - 1;
    }
    doc->cur = ed_pos_to_index(doc, target, col);
    doc->goal_col = col;
}

size_t ED_line_count(const ED_Doc *doc)
{
    return ed_valid(doc) ? ed_doc_lines(doc) : 0;
}

size_t ED_line_len(const ED_Doc *doc, size_t row)
{
    if (!ed_valid(doc) || row >= ed_doc_lines(doc)) {
        return 0;
    }
    if (doc->store != NULL) {
        size_t start, len;

        return ED_Store_line_bounds(doc->store, row, &start, &len) ==
               ED_STORE_OK ? len : 0;
    }
    return ed_line_end(doc, row) - ed_line_start(doc, row);
}

const char *ED_line_text(const ED_Doc *doc, size_t row)
{
    if (!ed_valid(doc) || row >= ed_doc_lines(doc) || doc->store != NULL) {
        return "";
    }
    return doc->buf + ed_line_start(doc, row);
}

bool ED_is_dirty(const ED_Doc *doc)
{
    return ed_valid(doc) ? doc->dirty : false;
}

void ED_clear_dirty(ED_Doc *doc)
{
    if (ed_valid(doc)) {
        doc->dirty = false;
    }
}
```

## src/editor_session.c
```c
/*
 * editor_session.c - Interactive editing session.
 *
 * Owns the event loop for one edit run: load file, draw, read key, apply
 * action, repeat until save or quit. Keys handled:
 *   printable chars  insert        Backspace  delete before cursor
 *   Enter            split line     Delete     delete at cursor
 *   Tab              insert spaces  arrows     move cursor
 *   Home/End         line start/end PgUp/PgDn  move by a page
 *   Ctrl-W           write          Ctrl-X     exit
 * Without a file name, Ctrl-W asks for one; Ctrl-X with unsaved changes
 * asks whether to save. Ctrl-C cancels a prompt.
 */
#include <stdio.h>
#include <string.h>

#include "editor_config.h"
#include "editor_session.h"
#include "fs_lfs.h"

static void set_status(char *status, size_t cap, const char *path,
                       const ED_Doc *doc, const char *msg)
{
    size_t row, col;

    ED_get_cursor(doc, &row, &col);
    snprintf(status, cap, "%s%s | Ln %lu, Col %lu | ^W write ^X exit%s%s",
             path[0] != '\0' ? path : "(no name)",
             ED_is_dirty(doc) ? " [+]" : "",
             (unsigned long)(row + 1), (unsigned long)(col + 1),
             msg != NULL ? " | " : "",
             msg != NULL ? msg : "");
}

/* Keys that only move the cursor and never change the text. */
static bool is_motion_key(TERM_KeyType type)
{
    switch (type) {
    case TERM_KEY_UP:
    case TERM_KEY_DOWN:
    case TERM_KEY_LEFT:
    case TERM_KEY_RIGHT:
    case TERM_KEY_HOME:
    case TERM_KEY_END:
    case TERM_KEY_PAGE_UP:
    case TERM_KEY_PAGE_DOWN:
        return true;
    default:
        return false;
    }
}

/* Read a line on the status row. Ctrl-C cancels; empty Enter is ignored. */
static bool prompt_line(TERM *t, const ED_View *v, const char *prompt,
                        char *out, size_t cap)
{
    size_t len = 0;
    TERM_Key key;

    out[0] = '\0';
    for (;;) {
        TERM_hide_cursor(t);
        TERM_move_to(t, EDV_text_rows(v), 0);
        TERM_reverse_video(t);
        TERM_write(t, prompt);
        TERM_write(t, out);
        TERM_clear_line(t);
        TERM_normal_video(t);
        TERM_show_cursor(t);

        if (!TERM_read_key(t, &key)) {
            return false;
        }
        switch (key.type) {
        case TERM_KEY_CTRL_C:
            return false;
        case TERM_KEY_ENTER:
            if (len > 0) {
                return true;
            }
            break;
        case TERM_KEY_BACKSPACE:
            if (len > 0) {
                out[--len] = '\0';
            }
            break;
        case TERM_KEY_CHAR:
            if (len + 1 < cap) {
                out[len++] = key.ch;
                out[len] = '\0';
            }
            break;
        default:
            break;
        }
    }
}

static size_t store_read_at(void *ctx, size_t offset, char *dst, size_t len)
{
    return ED_Store_read((ED_Store *)ctx, offset, dst, len) == ED_STORE_OK ?
           len : 0;
}

static bool reset_store(const ED_SessionConfig *cfg, ED_Doc *doc,
                        const char *path)
{
    size_t cursor = doc->cur, row, col, source_len = 0;
    FS_LFS_Result frc;

    FS_LFS_close(cfg->source);
    frc = FS_LFS_open_read(path, cfg->source);
    if (frc == FS_LFS_OK) {
        source_len = cfg->source->size;
    } else if (frc != FS_LFS_NOT_FOUND) {
        return false;
    }
    ED_Store_init(cfg->store, FS_LFS_read_at, cfg->source, source_len,
                  cfg->pieces, cfg->pieces_cap, cfg->added, cfg->added_cap,
                  cfg->cache, cfg->cache_cap, cfg->anchors, cfg->anchors_cap);
    ED_init_store(doc, cfg->store);
    if (cursor > doc->len) {
        cursor = doc->len;
    }
    doc->cur = cursor;
    (void)ED_Store_position_at(cfg->store, cursor, &row, &col);
    doc->goal_col = col;
    return true;
}

static const char *save_doc(const ED_SessionConfig *cfg, ED_Doc *doc,
                            TERM *t, const ED_View *v,
                            char *path, size_t path_cap)
{
    char old_path[EDITOR_PATH_MAX];
    bool source_was_open;

    if (path[0] == '\0' &&
        !prompt_line(t, v, "Write to: ", path, path_cap)) {
        return "cancelled";
    }
    if (doc->store != NULL) {
        if (!ED_is_dirty(doc) && cfg->source->open &&
            strcmp(path, cfg->source->path) == 0) {
            return "unchanged";
        }
        source_was_open = cfg->source->open;
        strcpy(old_path, cfg->source->path);
        if (FS_LFS_save_stream(path, ED_get_text(doc), store_read_at,
                               doc->store, cfg->source) != FS_LFS_OK) {
            if (source_was_open && !cfg->source->open) {
                (void)reset_store(cfg, doc, old_path);
            }
            return "save failed";
        }
        if (!reset_store(cfg, doc, path)) {
            return "saved; reopen failed";
        }
    } else if (FS_LFS_save(path, doc->buf, ED_get_text(doc)) != FS_LFS_OK) {
        return "save failed";
    }
    ED_clear_dirty(doc);
    return "saved";
}

/* Apply one editing key. Returns the message to show in the status line
 * (or NULL) after the action. */
static const char *apply_key(const ED_SessionConfig *cfg, ED_Doc *doc,
                             ED_View *view, TERM *term,
                             const TERM_Key *key, char *path,
                             size_t path_cap, bool *quit)
{
    switch (key->type) {
    case TERM_KEY_CHAR:
        {
            ED_Result rc = ED_insert_char(doc, key->ch);

            if (rc != ED_OK) {
                return rc == ED_FULL ? "edit memory full" : "storage error";
            }
        }
        break;
    case TERM_KEY_TAB: {
        size_t row, col, i, spaces;

        ED_get_cursor(doc, &row, &col);
        spaces = EDITOR_TAB_WIDTH - (EDV_display_col(doc, row, col) %
                                     EDITOR_TAB_WIDTH);
        for (i = 0; i < spaces; i++) {
            ED_Result rc = ED_insert_char(doc, ' ');

            if (rc != ED_OK) {
                return rc == ED_FULL ? "edit memory full" : "storage error";
            }
        }
        break;
    }
    case TERM_KEY_ENTER:
        {
            ED_Result rc = ED_newline(doc);

            if (rc != ED_OK) {
                return rc == ED_FULL ? "edit memory full" : "storage error";
            }
        }
        break;
    case TERM_KEY_BACKSPACE:   ED_backspace(doc);   break;
    case TERM_KEY_DELETE:      ED_delete(doc);      break;
    case TERM_KEY_UP:          ED_move_up(doc);     break;
    case TERM_KEY_DOWN:        ED_move_down(doc);   break;
    case TERM_KEY_LEFT:        ED_move_left(doc);   break;
    case TERM_KEY_RIGHT:       ED_move_right(doc);  break;
    case TERM_KEY_HOME:        ED_cursor_home(doc); break;
    case TERM_KEY_END:         ED_cursor_end(doc);  break;
    case TERM_KEY_PAGE_UP:
        ED_move_page_up(doc, EDV_text_rows(view));
        break;
    case TERM_KEY_PAGE_DOWN:
        ED_move_page_down(doc, EDV_text_rows(view));
        break;
    case TERM_KEY_CTRL_W:
        return save_doc(cfg, doc, term, view, path, path_cap);
    case TERM_KEY_CTRL_X: {
        char ans[4];
        const char *m;

        if (!ED_is_dirty(doc)) {
            *quit = true;
            break;
        }
        if (!prompt_line(term, view, "Save changes? (y/n): ", ans,
                         sizeof(ans))) {
            return "cancelled";
        }
        if (ans[0] == 'n' || ans[0] == 'N') {
            *quit = true;
            break;
        }
        if (ans[0] != 'y' && ans[0] != 'Y') {
            return "cancelled";
        }
        m = save_doc(cfg, doc, term, view, path, path_cap);
        if (strcmp(m, "saved") == 0) {
            *quit = true;
        }
        return m;
    }
    case TERM_KEY_NONE:
    default:
        break;
    }
    return NULL;
}

ED_SessionResult ED_Session_run(const ED_SessionConfig *cfg)
{
    ED_Doc doc;
    ED_View view;
    TERM_Key key;
    bool quit = false;
    bool full_redraw = true;
    char status[EDITOR_STATUS_MAX];
    char path[EDITOR_PATH_MAX];
    const char *msg = NULL;
    size_t loaded_len = 0;
    FS_LFS_Result frc;

    if (cfg == NULL || cfg->term == NULL ||
          (cfg->store == NULL &&
            (cfg->buf == NULL || cfg->lines == NULL || cfg->buf_cap == 0 ||
             cfg->lines_cap == 0)) ||
          (cfg->store != NULL &&
            (cfg->pieces == NULL || cfg->pieces_cap == 0 || cfg->added == NULL ||
             cfg->cache == NULL || cfg->cache_cap == 0 || cfg->source == NULL))) {
        return ED_SESSION_ARG_ERROR;
    }
    path[0] = '\0';
    if (cfg->path != NULL) {
        if (strlen(cfg->path) >= sizeof(path)) {
            return ED_SESSION_ARG_ERROR;
        }
        strcpy(path, cfg->path);
    }

    EDV_init(&view, cfg->term_rows, cfg->term_cols);

    if (cfg->store != NULL) {
        size_t source_len = 0;

        FS_LFS_close(cfg->source);
        frc = (path[0] != '\0') ? FS_LFS_open_read(path, cfg->source) :
                                   FS_LFS_NOT_FOUND;
        if (frc == FS_LFS_OK) {
            source_len = cfg->source->size;
        } else if (frc == FS_LFS_NOT_FOUND) {
            msg = "new file";
        } else {
            return ED_SESSION_IO_ERROR;
        }
        ED_Store_init(cfg->store, FS_LFS_read_at, cfg->source, source_len,
                      cfg->pieces, cfg->pieces_cap, cfg->added,
                      cfg->added_cap, cfg->cache, cfg->cache_cap,
                      cfg->anchors, cfg->anchors_cap);
        ED_init_store(&doc, cfg->store);
    } else {
        ED_init(&doc, cfg->buf, cfg->buf_cap, cfg->lines, cfg->lines_cap);
        frc = (path[0] != '\0') ?
              FS_LFS_load(path, cfg->buf, cfg->buf_cap, &loaded_len) :
              FS_LFS_NOT_FOUND;
        switch (frc) {
        case FS_LFS_OK:
            ED_set_text(&doc, cfg->buf, loaded_len);
            break;
        case FS_LFS_NOT_FOUND:
            ED_set_text(&doc, NULL, 0);
            msg = "new file";
            break;
        case FS_LFS_TOO_LARGE:
            msg = "file truncated";
            ED_set_text(&doc, cfg->buf, loaded_len);
            break;
        default:
            return ED_SESSION_IO_ERROR;
        }
    }

    TERM_enter(cfg->term);

    while (!quit) {
        size_t old_top = view.top, old_left = view.left;

        EDV_ensure_cursor_visible(&view, &doc);
        set_status(status, sizeof(status), path, &doc, msg);
        if (full_redraw || view.top != old_top || view.left != old_left) {
            TERM_render(cfg->term, &doc, &view, status);
        } else {
            TERM_render_cursor(cfg->term, &doc, &view, status);
        }

        msg = NULL;
        if (!TERM_read_key(cfg->term, &key)) {
            break;  /* input stream ended: leave the editor */
        }
        if (key.type == TERM_KEY_NONE) {
            full_redraw = false;
            continue;
        }
        full_redraw = !is_motion_key(key.type);
        msg = apply_key(cfg, &doc, &view, cfg->term, &key, path,
                sizeof(path), &quit);
    }

    TERM_exit(cfg->term);
    if (cfg->store != NULL) {
        FS_LFS_close(cfg->source);
    }

    return ED_is_dirty(&doc) ? ED_SESSION_DISCARDED : ED_SESSION_OK;
}
```
